## conf/bblayers.conf.sample
```bitbake
# LAYER_CONF_VERSION is increased each time build/conf/bblayers.conf
# changes incompatibly
LCONF_VERSION = "5"

BBPATH = "${TOPDIR}"
BBFILES ?= ""

BBLAYERS ?= " \
  ##COREBASE##/meta \
  ##COREBASE##/../meta-ettus \
  ##COREBASE##/../meta-xilinx \
  ##COREBASE##/../meta-openembedded/meta-oe \
  ##COREBASE##/../meta-openembedded/meta-networking \
  ##COREBASE##/../meta-openembedded/meta-filesystems \
  ##COREBASE##/../meta-openembedded/meta-python \
  ##COREBASE##/../meta-sdr \
  ##COREBASE##/../meta-echoridge \
  "
```

## conf/machine/er300.conf
```bitbake
#@TYPE: Machine
#@Name: Ettus Research E3XX.
#@DESCRIPTION: Machine configuration for the Ettus Research E3XX Software Radio.

MACHINEOVERRIDES = "${MACHINE}"

PREFERRED_PROVIDER_virtual/kernel ?= "linux-xlnx"
PREFERRED_VERSION_linux-xlnx ?= "3.14%"

MACHINE_FEATURES = "vfat ethernet ext2"

SERIAL_CONSOLE = "115200 ttyPS0"

include conf/machine/include/tune-zynq.inc
require conf/machine/include/machine-xilinx-default.inc
require conf/machine/include/machine-xilinx-board.inc

PREFERRED_PROVIDER_virtual/bootloader ?= "u-boot"

UBOOT_BINARY_er300 = "u-boot.img"
UBOOT_MACHINE_er300 = "zynq_zed_defconfig"

MACHINE_ESSENTIAL_EXTRA_RDEPENDS_remove = "device-tree"

MACHINE_EXTRA_RRECOMMENDS = "kernel-modules  \
                             e3xx-udev-rules \
                            "
 
IMAGE_BOOT_FILES += ""
EXTRA_IMAGEDEPENDS = ""

KERNEL_CLASSES += "kernel-fitimage"
KERNEL_IMAGETYPE = "fitImage"
KERNEL_DEVICETREE = "zynq-er300.dtb"
```
